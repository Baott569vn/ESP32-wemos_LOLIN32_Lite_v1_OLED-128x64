/*********
  Rui Santos
  Complete project details at https://randomnerdtutorials.com  
*********/

#include <Wire.h>
#include <Adafruit_GFX.h>
#include <Adafruit_SSD1306.h>

#define SCREEN_WIDTH 128
#define SCREEN_HEIGHT 64

Adafruit_SSD1306 display(SCREEN_WIDTH, SCREEN_HEIGHT, &Wire, -1);

// 'nen', 128x64px
const unsigned char epd_bitmap_nen[] PROGMEM = {
  0x7f, 0xef, 0xe7, 0x9f, 0x3f, 0xff, 0xef, 0x9f, 0xff, 0xff, 0xff, 0xff, 0xff, 0xff, 0xff, 0xff,
  0x7f, 0xef, 0xef, 0x9f, 0x3e, 0xfb, 0xef, 0x9f, 0xff, 0xff, 0xff, 0xff, 0xff, 0xff, 0xff, 0xff,
  0xff, 0xef, 0xe7, 0xdf, 0x3e, 0xfb, 0xef, 0x9f, 0xff, 0xff, 0xf1, 0xff, 0xff, 0xff, 0xff, 0xff,
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  0xff, 0xff, 0xef, 0xdf, 0x7d, 0xf7, 0xff, 0x1f, 0x06, 0x38, 0xe1, 0xf9, 0xf9, 0xc3, 0xe3, 0xc7
};

const char sybol[] = { '-', '\\', '|', '/' };

void setup() {
  Serial.begin(115200);
  randomSeed(0);
  // Start I2C Communication SDA = 5 and SCL = 4 on Wemos Lolin32 ESP32 with built-in SSD1306 OLED
  Wire.begin(5, 4);

  if (!display.begin(SSD1306_SWITCHCAPVCC, 0x3C, false, false)) {
    Serial.println(F("SSD1306 allocation failed"));
    for (;;)
      ;
  }

  delay(5000);  // Pause for 2 seconds
  // Clear the buffer.
  display.clearDisplay();

  // Draw bitmap on the screen
  display.drawBitmap(0, 0, epd_bitmap_nen, 128, 64, 1);
  display.display();
  delay(5000);
  display.clearDisplay();
  display.setTextSize(1);
  display.setTextColor(WHITE);
}

void loadingDis() {
  int lengData = sizeof(sybol) / sizeof(sybol[0]);
  byte seedRan = random(0, 20 + 1);
  for (int i{ 0 }; i <= seedRan; ++i) {
    display.setCursor(16, 32);
    display.println(String(F("loading... ")) + sybol[i % lengData]);
    display.display();
    delay(100);
    display.clearDisplay();
  }
}

String generateRandomString(int length) {
  String characters = "ABCDEFGHIJKLMNOPQRSTUVWXYZabcdefghijklmnopqrstuvwxyz0123456789";
  String randomString = "";

  for (int i = 0; i < length; i++) {
    int randomIndex = random(characters.length());
    randomString += characters.charAt(randomIndex);
  }

  return randomString;
}

void displaY() {
  int seedRan_ID = random(10, 100 + 1);
  for (int a{ 0 }; a <= 200; ++a) {
    byte length_ranKey = random(10, 30 + 1);
    display.setCursor(16, 20);
    display.println(F("Is Show:"));
    display.setCursor(0, 35);
    String flashString = F("text: ");
    display.println(flashString + generateRandomString(length_ranKey));
    display.display();
    delay(seedRan_ID);
    display.clearDisplay();
    delay(seedRan_ID);
  }
}

void loop() {
  loadingDis();
  delay(500);
  displaY();
}